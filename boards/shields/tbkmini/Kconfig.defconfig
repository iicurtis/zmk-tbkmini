## boards/shields/tbkmini/Kconfig.defconfig
```kconfig
if SHIELD_TBKMINI_DONGLE

config ZMK_KEYBOARD_NAME
    default "TBKMini_isaac"

config ZMK_SPLIT_ROLE_CENTRAL
    default y

config ZMK_SPLIT
    default y

config ZMK_SPLIT_BLE_CENTRAL_PERIPHERALS
    default 2

# Set this to ZMK_SPLIT_BLE_CENTRAL_PERIPHERALS + your desired number of BT profiles (default is 5)
config BT_MAX_CONN
    default 7

# Set this to the same number as BT_MAX_CONN
config BT_MAX_PAIRED
    default 7


config ZMK_USB
	default y

endif

if SHIELD_TBKMINI_LEFT || SHIELD_TBKMINI_RIGHT || SHIELD_TBKMINI_DONGLE

config ZMK_SPLIT
    default y

config ZMK_BLE
	default y

endif
```

## boards/shields/tbkmini/Kconfig.shield
```kconfig
config SHIELD_TBKMINI_DONGLE
    def_bool $(shields_list_contains,tbkmini_dongle)

config SHIELD_TBKMINI_LEFT
    def_bool $(shields_list_contains,tbkmini_left)

config SHIELD_TBKMINI_RIGHT
    def_bool $(shields_list_contains,tbkmini_right)
```
